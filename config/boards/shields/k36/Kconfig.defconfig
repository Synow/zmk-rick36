## config/boards/shields/k36/Kconfig.defconfig
```kconfig
config ZMK_BLE
	default y


if SHIELD_K36_LEFT

config ZMK_KEYBOARD_NAME
	default "K36"

config ZMK_SPLIT_BLE_ROLE_CENTRAL
  default y

endif


if SHIELD_K36_RIGHT

config ZMK_KEYBOARD_NAME
	default "K36 Right"

endif

if SHIELD_K36_LEFT || SHIELD_K36_RIGHT

config ZMK_SPLIT
	default y
 
endif
```

## config/west.yml
```yaml
manifest:
  remotes:
    - name: zmkfirmware
      url-base: https://github.com/ftc/     # Mouse layers
  projects:
    - name: zmk
      remote: zmkfirmware
      revision: mouse-ftc                   # <--- CHANGE REVISION
      import: app/west.yml
  self:
    path: config
```
